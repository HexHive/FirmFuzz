## framework/kernel_firmfuzz_armel/drivers/firmfuzz/Kconfig
```kconfig
#config FIRMADYNE
#	bool "FIRMADYNE: Dynamic firmware analysis"
#	help
#		These are kernel changes to support firmware emulation and analysis.
config FIRMFUZZ
	bool "FIRMFUZZ: Dynamic firmware analysis"
	help
		These are kernel changes to support firmware emulation and analysis.
```
